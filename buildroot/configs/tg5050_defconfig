## buildroot/configs/tg5050_defconfig
```kconfig
# Buildroot config for TrimUI Smart Pro S (TG5050)
# Full tier: QT6, Wayland, Mesa3D, modern libraries
# SoC: Allwinner A523 (Octa-core A53/A73, Mali-G57)
# RAM: 2GB

# Architecture
BR2_aarch64=y
BR2_cortex_a73=y

# Toolchain
BR2_TOOLCHAIN_EXTERNAL=y
BR2_TOOLCHAIN_EXTERNAL_CUSTOM=y
BR2_TOOLCHAIN_EXTERNAL_PATH="$(BR2_EXTERNAL TrimUI_PATH)/toolchain"
BR2_TOOLCHAIN_EXTERNAL_CUSTOM_PREFIX="aarch64-buildroot-linux-gnu"
BR2_TOOLCHAIN_EXTERNAL_GCC_13=y
BR2_TOOLCHAIN_EXTERNAL_CUSTOM_GLIBC=y

# Kernel (not needed for chroot, but included for reference)
BR2_LINUX_KERNEL=y
BR2_LINUX_KERNEL_CUSTOM_VERSION=y
BR2_LINUX_KERNEL_CUSTOM_VERSION_VALUE="6.1.50"
BR2_LINUX_KERNEL_USE_CUSTOM_CONFIG=y
BR2_LINUX_KERNEL_CUSTOM_CONFIG_FILE="$(BR2_EXTERNAL TrimUI_PATH)/configs/tg5050_kernel.config"

# Root filesystem
BR2_TARGET_ROOTFS_EXT2=y
BR2_TARGET_ROOTFS_EXT2_4=y
BR2_TARGET_ROOTFS_EXT2_SIZE="1G"
BR2_TARGET_ROOTFS_EXT2_LABEL="BUILDROOT"

# System
BR2_TARGET_GENERIC_HOSTNAME="jukamix-tg5050"
BR2_TARGET_GENERIC_ISSUE="Welcome to JukaMix OS Buildroot (TG5050)"
BR2_INIT_SYSV=y
BR2_ROOTFS_DEVICE_CREATION_DYNAMIC_MDEV=y

# Packages - Core
# Note: glibc is configured via BR2_TOOLCHAIN_BUILDROOT_GLIBC above
BR2_PACKAGE_BASH=y
BR2_PACKAGE_COREUTILS=y
BR2_PACKAGE_FINDUTILS=y
BR2_PACKAGE_GREP=y
BR2_PACKAGE_SED=y
BR2_PACKAGE_UTIL_LINUX=y
BR2_PACKAGE_PROCPS_NG=y

# Packages - Development
# Note: gcc is part of the toolchain, not a target package
BR2_PACKAGE_MAKE=y
BR2_PACKAGE_PKG_CONFIG=y
BR2_PACKAGE_CMAKE=y
BR2_PACKAGE_NINJA=y

# Packages - Libraries (QT6)
BR2_PACKAGE_QT6=y
BR2_PACKAGE_QT6BASE=y
BR2_PACKAGE_QT6BASE_CONCURRENT=y
BR2_PACKAGE_QT6BASE_DBUS=y
BR2_PACKAGE_QT6BASE_GUI=y
BR2_PACKAGE_QT6BASE_NETWORK=y
BR2_PACKAGE_QT6BASE_SQL=y
BR2_PACKAGE_QT6BASE_XML=y
BR2_PACKAGE_QT6DECLARATIVE=y
BR2_PACKAGE_QT6IMAGEFORMATS=y
BR2_PACKAGE_QT6MULTIMEDIA=y
BR2_PACKAGE_QT6SHADERTOOL=y
BR2_PACKAGE_QT6SVG=y
BR2_PACKAGE_QT6WAYLAND=y
BR2_PACKAGE_QT6WEBSOCKETS=y

# Packages - Graphics
BR2_PACKAGE_MESA3D=y
BR2_PACKAGE_MESA3D_GALLIUM_DRIVER_FREEDRENO=y
BR2_PACKAGE_MESA3D_OPENGL_ES=y
BR2_PACKAGE_MESA3D_GLX=y
BR2_PACKAGE_WAYLAND=y
BR2_PACKAGE_WAYLAND_PROTOCOLS=y
BR2_PACKAGE_LIBDRM=y
BR2_PACKAGE_LIBEPOXY=y

# Packages - Networking
BR2_PACKAGE_CURL=y
BR2_PACKAGE_WGET=y
BR2_PACKAGE_OPENSSL=y
BR2_PACKAGE_NGHTTP2=y

# Packages - Languages
BR2_PACKAGE_PYTHON3=y
BR2_PACKAGE_NODEJS=y

# Packages - Compression
BR2_PACKAGE_ZSTD=y
BR2_PACKAGE_XZ=y
BR2_PACKAGE_LZ4=y

# Packages - Filesystem
BR2_PACKAGE_DOSFSTOOLS=y
BR2_PACKAGE_E2FSPROGS=y
BR2_PACKAGE_MTD=y
BR2_PACKAGE_UBOOT_TOOLS=y

# Packages - Misc
BR2_PACKAGE_HTOP=y
BR2_PACKAGE_NANO=y
BR2_PACKAGE_TREE=y
BR2_PACKAGE_FILE=y
BR2_PACKAGE_STRACE=y
BR2_PACKAGE_LTRACE=y

# Filesystem overlay
BR2_ROOTFS_OVERLAY="$(BR2_EXTERNAL TrimUI_PATH)/overlay"

# Post-build script
BR2_ROOTFS_POST_BUILD_SCRIPT="$(BR2_EXTERNAL TrimUI_PATH)/scripts/post_build.sh"
```

## buildroot/configs/tsp_brick_defconfig
```kconfig
# Buildroot config for TrimUI Smart Pro (TSP) and Brick
# Minimal tier: Modern glibc, no QT6/Wayland (too heavy for 1GB)
# SoC: Allwinner A133 (Single-core A53, Mali-G31)
# RAM: 1GB

# Architecture
BR2_aarch64=y
BR2_cortex_a53=y

# Toolchain
BR2_TOOLCHAIN_EXTERNAL=y
BR2_TOOLCHAIN_EXTERNAL_CUSTOM=y
BR2_TOOLCHAIN_EXTERNAL_PATH="$(BR2_EXTERNAL TrimUI_PATH)/toolchain"
BR2_TOOLCHAIN_EXTERNAL_CUSTOM_PREFIX="aarch64-buildroot-linux-gnu"
BR2_TOOLCHAIN_EXTERNAL_GCC_13=y
BR2_TOOLCHAIN_EXTERNAL_CUSTOM_GLIBC=y

# Root filesystem (smaller for 1GB RAM)
BR2_TARGET_ROOTFS_EXT2=y
BR2_TARGET_ROOTFS_EXT2_4=y
BR2_TARGET_ROOTFS_EXT2_SIZE="512M"
BR2_TARGET_ROOTFS_EXT2_LABEL="BUILDROOT"

# System
BR2_TARGET_GENERIC_HOSTNAME="jukamix-tsp-brick"
BR2_TARGET_GENERIC_ISSUE="Welcome to JukaMix OS Buildroot (TSP/Brick)"
BR2_INIT_SYSV=y
BR2_ROOTFS_DEVICE_CREATION_DYNAMIC_MDEV=y

# Packages - Core
BR2_PACKAGE_GLIBC=y
BR2_PACKAGE_GLIBC_2_44=y
BR2_PACKAGE_BASH=y
BR2_PACKAGE_COREUTILS=y
BR2_PACKAGE_FINDUTILS=y
BR2_PACKAGE_GREP=y
BR2_PACKAGE_SED=y
BR2_PACKAGE_UTIL_LINUX=y
BR2_PACKAGE_PROCPS_NG=y

# Packages - Development
BR2_PACKAGE_GCC=y
BR2_PACKAGE_GCC_13=y
BR2_PACKAGE_MAKE=y
BR2_PACKAGE_PKG_CONFIG=y

# Packages - Libraries (NO QT6/Wayland - too heavy)
BR2_PACKAGE_QT6=n
BR2_PACKAGE_WAYLAND=n
BR2_PACKAGE_MESA3D=y
BR2_PACKAGE_MESA3D_GALLIUM_DRIVER_FREEDRENO=y
BR2_PACKAGE_MESA3D_OPENGL_ES=y
BR2_PACKAGE_MESA3D_GLES2=y
BR2_PACKAGE_LIBDRM=y
BR2_PACKAGE_LIBEPOXY=y

# Packages - Networking
BR2_PACKAGE_CURL=y
BR2_PACKAGE_WGET=y
BR2_PACKAGE_OPENSSL=y
BR2_PACKAGE_OPENSSL_3=y
BR2_PACKAGE_NGHTTP2=y

# Packages - Languages
BR2_PACKAGE_PYTHON3=y
BR2_PACKAGE_PYTHON3_12=y
BR2_PACKAGE_NODEJS=y
BR2_PACKAGE_NODEJS_20=y

# Packages - Compression
BR2_PACKAGE_ZSTD=y
BR2_PACKAGE_XZ=y
BR2_PACKAGE_LZ4=y

# Packages - Filesystem
BR2_PACKAGE_DOSFSTOOLS=y
BR2_PACKAGE_E2FSPROGS=y

# Packages - Misc
BR2_PACKAGE_HTOP=y
BR2_PACKAGE_NANO=y
BR2_PACKAGE_TREE=y
BR2_PACKAGE_FILE=y

# Filesystem overlay
BR2_ROOTFS_OVERLAY="$(BR2_EXTERNAL TrimUI_PATH)/overlay"

# Post-build script
BR2_ROOTFS_POST_BUILD_SCRIPT="$(BR2_EXTERNAL TrimUI_PATH)/scripts/post_build.sh"
```
